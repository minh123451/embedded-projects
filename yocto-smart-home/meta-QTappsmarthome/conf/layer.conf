## yocto-smart-home/meta-QTappsmarthome/conf/layer.conf
```bitbake
# We have a conf and classes directory, add to BBPATH
BBPATH .= ":${LAYERDIR}"

# We have recipes-* directories, add to BBFILES
BBFILES += "${LAYERDIR}/recipes-*/*/*.bb \
            ${LAYERDIR}/recipes-*/*/*.bbappend"

BBFILE_COLLECTIONS += "meta-QTappsmarthome"
BBFILE_PATTERN_meta-QTappsmarthome = "^${LAYERDIR}/"
BBFILE_PRIORITY_meta-QTappsmarthome = "6"

LAYERDEPENDS_meta-QTappsmarthome = "core"
LAYERSERIES_COMPAT_meta-QTappsmarthome = "dunfell"
```

## yocto-smart-home/meta-gpio_driver/conf/layer.conf
```bitbake
# We have a conf and classes directory, add to BBPATH
BBPATH .= ":${LAYERDIR}"

# We have recipes-* directories, add to BBFILES
BBFILES += "${LAYERDIR}/recipes-*/*/*.bb \
            ${LAYERDIR}/recipes-*/*/*.bbappend"

BBFILE_COLLECTIONS += "meta-gpio_driver"
BBFILE_PATTERN_meta-gpio_driver = "^${LAYERDIR}/"
BBFILE_PRIORITY_meta-gpio_driver = "6"

LAYERDEPENDS_meta-gpio_driver = "core"
LAYERSERIES_COMPAT_meta-gpio_driver = "dunfell"
```

## yocto-smart-home/meta-mydriver/conf/layer.conf
```bitbake
# We have a conf and classes directory, add to BBPATH
BBPATH .= ":${LAYERDIR}"

# We have recipes-* directories, add to BBFILES
BBFILES += "${LAYERDIR}/recipes-*/*/*.bb \
            ${LAYERDIR}/recipes-*/*/*.bbappend"

BBFILE_COLLECTIONS += "meta-mydriver"
BBFILE_PATTERN_meta-mydriver = "^${LAYERDIR}/"
BBFILE_PRIORITY_meta-mydriver = "6"

LAYERDEPENDS_meta-mydriver = "core"
LAYERSERIES_COMPAT_meta-mydriver = "dunfell"
```
